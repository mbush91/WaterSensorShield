## ws-zephyr/src/lib/Kconfig
```kconfig
menu "Libraries"
rsource "battery/Kconfig"
rsource "scheduler/Kconfig"
rsource "pss_nrf_lte/Kconfig"
rsource "pss_mqtt/Kconfig"
rsource "mqtt_helper/Kconfig"
endmenu
```

## ws-zephyr/src/lib/battery/Kconfig
```kconfig
menu "Battery Library for sampling battery voltage"

config BATTERY_LIB
	bool "BATTERY lib Support"
	help
	  This option enables the battery measure library

config BATTERY_LIB_GPIO_EN
	bool "BATTERY toggle GPIO before reads"
	default n
	help
	  This option enables the battery measure library

config BATTERY_LIB_MAX_VOLTAGE
	int "Battery max voltage in mV"
	depends on BATTERY_LIB
	default 4200
	help
	  This option sets the battery max voltage

config BATTERY_LIB_LOW_VOLTAGE
	int "Battery low voltage in mV (should be about where the discharge curve knee is)"
	depends on BATTERY_LIB
	default 3400
	help
	  This option sets the battery min voltage

config BATTERY_LIB_MIN_OPERATING_VOLTAGE
	int "Battery min voltage in mV for system operation (0% battery)"
	depends on BATTERY_LIB
	default 3200
	help
	  This option sets the battery min voltage

config BATTERY_LIB_PLAUS_LOW_VOLTAGE
	int "Battery lowest voltage the battery can have in mV and be a valid battery"
	depends on BATTERY_LIB
	default 2800
	help
	  This option sets the battery low side plausibility voltage

config BATTERY_LIB_LOW_VOLTAGE_PERCENT
	int "Battery percentage at low voltage"
	depends on BATTERY_LIB
	default 10
	help
	  This option sets the battery min voltage

config BATTERY_LIB_DIV_R1
	int "Battery voltage divider R1 value (high side)"
	depends on BATTERY_LIB
	default 1200
	help
	  This option sets the battery div gain

config BATTERY_LIB_DIV_R2
	int "Battery voltage divider R2 value (low side)"
	depends on BATTERY_LIB
	default 3000
	help
	  This option sets the battery div gain

config BATTERY_LIB_VOTLAGE_DROP
	int "Approximate voltage drop from origianl source"
	depends on BATTERY_LIB
	default 0
	help
	  This option applies and offset to the battery mV

module = BATTERY
module-str = battery
source "subsys/logging/Kconfig.template.log_config"
endmenu
```

## ws-zephyr/src/lib/pss_mqtt/Kconfig
```kconfig
menu "PSS nrf9160 api MQTT component"

config PSS_MQTT_HOST
	string "The Host or Domain destination for MQTT Broker"
	default "pp.services.u-blox.com"
	help
	  Destination host/domain of the URL (for instance: 'example.com')


config PSS_MQTT_FORCE_PROVISION
    bool "Force MQTT Provisioning"
    default n
	help
	  This forces overwriting certs if they already exist.

config PSS_MQTT_DISABLE_SUBSCRIPTIONS
    bool "Disable MQTT Subscriptions"
    default n
	help
	  This disables MQTT subscriptions for testing

config PSS_MQTT_DUMP_HEX
    bool "Dump Hex Bytes to DBG log"
    default n
	help
	  This dumps received byted to the DBG logs.

module = PSS_MQTT
module-str = pss-mqtt
source "subsys/logging/Kconfig.template.log_config"
endmenu
```

## ws-zephyr/src/lib/pss_nrf_lte/Kconfig
```kconfig
menu "PSS NRF LTE lib"

config PSS_NRF_LTE
	bool "Use PSS NRF LTE library"
	help
	  This option enables the PSS NRF LTE library

config PSS_NRF_LTE_CONNECTION_STATISTICS
	bool "print connection statistics"
	help
	  print some extra stuff at inform log level

module = PSS_NRF_LTE
module-str = pss-nfr-lte
source "subsys/logging/Kconfig.template.log_config"
endmenu
```

## ws-zephyr/src/lib/scheduler/Kconfig
```kconfig
menu "PSS nrf9160 api scheduler component"
module = PSS_SCHEDULER
module-str = pss-scheduler

config PSS_SCHEDULER_DEBUGGER_EN
    bool "Disables overflow warnings for setting breakpoints"
    default n
	help
	  This disables the overflow warnings.

source "subsys/logging/Kconfig.template.log_config"
endmenu
```

## ws-zephyr/src/trigger/Kconfig
```kconfig
menu "GPIO Events"

module = TRIGGER
module-str = trigger
source "subsys/logging/Kconfig.template.log_config"
endmenu
```
